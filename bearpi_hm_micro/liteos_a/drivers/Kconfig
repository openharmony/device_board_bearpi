## bearpi_hm_micro/liteos_a/drivers/Kconfig
```kconfig
source "../../device/soc/st/common/platform/Kconfig"

config PLATFORM
    string
    default "stm32mp157"      if PLATFORM_STM32MP157

config PRODUCT_NAME
    string "product name"
    default "bearpi_hm_micro" if PRODUCT_BEARPI_HM_MICRO

config DEVICE_COMPANY
    string "vendor name"
    default "st" if PLATFORM_STM32MP157
    
config TEE_ENABLE
    bool "Enable TEE"
    default n
    depends on  PLATFORM_STM32MP157
    help
        Enable teeos in platform
```
